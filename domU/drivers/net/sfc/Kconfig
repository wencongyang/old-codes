## domU/drivers/net/sfc/Kconfig
```kconfig
config SFC
	tristate "Solarflare Solarstorm SFC4000/SFC9000-family support"
	depends on PCI && INET
	select CRC32
	select I2C
	select I2C_ALGOBIT
	help
	  This driver supports 10-gigabit Ethernet cards based on
	  the Solarflare Communications Solarstorm SFC4000 and
	  SFC9000-family controllers.

	  To compile this driver as a module, choose M here.  The module
	  will be called sfc.

config SFC_DEBUGFS
        bool "Solarflare Solarstorm SFC4000 debugging support"
        depends on SFC && DEBUG_FS
        default N
        help
          This option creates an "sfc" subdirectory of debugfs with
          debugging information for the SFC4000 driver.

          If unsure, say N.

config SFC_MTD
	bool "Solarflare Solarstorm SFC4000/SFC9000-family MTD support"
	depends on SFC && MTD && !(SFC=y && MTD=m)
	default y
	help
	  This exposes the on-board flash and/or EEPROM memory as MTD
	  devices (e.g. /dev/mtd1).  This makes it possible to upload
	  new boot code to the NIC.

config SFC_RESOURCE
        depends on SFC && X86
        tristate "Solarflare Solarstorm SFC4000/SFC9000 resource driver"
        help
          This module provides the SFC resource manager driver.
```

## domU/drivers/pci/Kconfig
```kconfig
#
# PCI configuration
#
config PCI_MSI
	bool "Message Signaled Interrupts (MSI and MSI-X)"
	depends on PCI
	depends on (X86_LOCAL_APIC && X86_IO_APIC) || IA64
	help
	   This allows device drivers to enable MSI (Message Signaled
	   Interrupts).  Message Signaled Interrupts enable a device to
	   generate an interrupt using an inbound Memory Write on its
	   PCI bus instead of asserting a device IRQ pin.

	   Use of PCI MSI interrupts can be disabled at kernel boot time
	   by using the 'pci=nomsi' option.  This disables MSI for the
	   entire system.

	   If you don't know what to do here, say N.

config PCI_REASSIGN
	bool

config PCI_DEBUG
	bool "PCI Debugging"
	depends on PCI && DEBUG_KERNEL
	help
	  Say Y here if you want the PCI core to produce a bunch of debug
	  messages to the system log.  Select this if you are having a
	  problem with PCI support and want to see more of what is going on.

	  When in doubt, say N.

config PCI_GUESTDEV
	bool "PCI Device Reservation for Passthrough"
	depends on PCI && ACPI
	default y
	help
	  Say Y here if you want to reserve PCI device for passthrough.

config PCI_IOMULTI
	bool "PCI Device IO Multiplex for Passthrough"
	depends on PCI && ACPI
	default y
	help
	  Say Y here if you need io multiplexing.

config PCI_RESERVE
	bool "PCI IO/MEMORY space reserve"
	depends on PCI
	default y
	help
	  Say Y here if you need PCI IO/MEMORY space reserve

config PCI_IOV
	bool "PCI IOV support"
	depends on PCI
	help
	  I/O Virtualization is a PCI feature supported by some devices
	  which allows them to create virtual devices which share their
	  physical resources.

	  If unsure, say N.
```
